## components/esp_system/port/soc/sf32lb57/Kconfig.cpu
```kconfig
# SPDX-License-Identifier: Apache-2.0
config SF32LB57_MAIN_TASK_STACK_SIZE
    int "Main task stack size (bytes)"
    range 2048 32768
    default 4096
    help
        The stack for app_main on the HCPU. The SiFli board support package configures the CPU clock.
```

## components/sf32lb57/Kconfig
```kconfig
# SPDX-License-Identifier: Apache-2.0
menu "SF32LB57 reference board"
    config SF32LB57_MAIN_TASK_STACK_SIZE
        int "Main task stack size (bytes)"
        range 2048 32768
        default 4096
endmenu
```

## components/sf32lb57/bsp/Kconfig.proj
```kconfig
# SPDX-License-Identifier: Apache-2.0
config CUSTOM_MEM_MAP
    bool
    default y
    select custom_mem_map
```
